## boards/vendor/lirisv3/board.yml
```yaml
# Copyright (c) 2024 Nordic Semiconductor ASA
# SPDX-License-Identifier: Apache-2.0

board:
  name: lirisv3
  vendor: vendor
  socs:
    - name: nrf52832
```

## boards/vendor/lirisv3/lirisv3_defconfig
```kconfig
# Copyright (c) 2021 Nordic Semiconductor ASA
# SPDX-License-Identifier: Apache-2.0

# Enable MPU
CONFIG_ARM_MPU=y

# enable GPIO
CONFIG_GPIO=y

# Enable UART console on all configurations for convenience. This is usually
# done at board level upstream so that all samples output printed messages to
# the configured #zephyr,console. In production boards, this may be enabled at
# application level or in a debug configuration overlay.
CONFIG_SERIAL=y
CONFIG_CONSOLE=y
CONFIG_UART_CONSOLE=y
```

## drivers/dac/Kconfig
```kconfig
# Copyright (c) 2021 Nordic Semiconductor ASA
# SPDX-License-Identifier: Apache-2.0

if DAC
rsource "ltc2640/Kconfig"
endif # DAC
```

## drivers/dac/ltc2640/Kconfig
```kconfig
config LTC2640
	bool "LTC2640 DAC Converter"
	default y
	select SPI
	help
	  Enable the driver for Analog Devices LTC2640 High-Accuracy
	  16-bit Digital SPI DAC Converter.

config LTC2640_DEBUG_LEVEL
	int "ltc2604 default debug level"
	default 3
	range 0 4
	help
	  Default ltc2604 debug logging level for Zephyr integration code
	  0 No debug
	  1 Error
	  2 State change
	  3 Information
	  4 Verbose
```

## drivers/eeprom/Kconfig
```kconfig
config EEPROM_25AAA
	bool "Microchip Eeprom 25aa0248 driver"
	depends on SPI
	default n
	help
	  Enable the driver for external microchip eeprom module.

config EEPROM_DEBUG_LEVEL
	int "eeprom default debug level"
	default 4
	range 0 4
	help
	  Default eeprom debug logging level for Zephyr integration code
	  0 No debug
	  1 Error
	  2 State change
	  3 Information
	  4 Verbose
```

## drivers/flash/Kconfig
```kconfig
config FRAM_CY15B104Q
	bool "Cypress CY15B104Q FRAM driver"
	depends on SPI
	default n
	help
	  Enable the driver for external microchip eeprom module.

config FRAM_CY15B104Q_DEBUG_LEVEL
	int "fram default debug level"
	default 4
	range 0 4
	help
	  Default fram debug logging level for Zephyr integration code
	  0 No debug
	  1 Error
	  2 State change
	  3 Information
	  4 Verbose
```

## drivers/sensor/Kconfig
```kconfig
# Copyright (c) 2021 Nordic Semiconductor ASA
# SPDX-License-Identifier: Apache-2.0

if SENSOR
rsource "adt7320/Kconfig"
rsource "ad7685/Kconfig"
endif # SENSOR
```

## drivers/sensor/ad7685/Kconfig
```kconfig
config AD7685
	bool "AD7685 16-Bits SPI ADC"
	default y
	select SPI
	help
	  Enable the driver for Analog Devices AD7685 High-Accuracy
	  16-bit Digital SPI ADC.

config AD7685_DEBUG_LEVEL
	int "AD7685 default debug level"
	default 3
	range 0 4
	help
	  Default AD7685 debug logging level for Zephyr integration code
	  0 No debug
	  1 Error
	  2 State change
	  3 Information
	  4 Verbose
```

## drivers/sensor/adt7320/Kconfig
```kconfig
config ADT7320
	bool "ADT7320 Temperature Sensor"
	default y
	select SPI
	help
	  Enable the driver for Analog Devices ADT7320 High-Accuracy
	  16-bit Digital SPI Temperature Sensors

config ADT7320_DEBUG_LEVEL
	int "adt7320 default debug level"
	default 3
	range 0 4
	help
	  Default adt7320 debug logging level for Zephyr integration code
	  0 No debug
	  1 Error
	  2 State change
	  3 Information
	  4 Verbose
```

## dts/bindings/dac/adi,ltc2640.yaml
```yaml
# Copyright (c) 2019, Linaro Limited
# SPDX-License-Identifier: Apache-2.0

include: [dac-controller.yaml, spi-device.yaml]

description: LTC2640 16-Bit digital SPI DAC

compatible: "adi,ltc2640"

properties:
  "#io-channel-cells":
    const: 1

  resolution:
    type: int
    required: true
    description: DAC resolution.

  voltage-reference-mv:
    type: int
    required: true
    description: DAC reference voltage in mV.

io-channel-cells:
  - output
```

## dts/bindings/mtd/cypress,cy15b104q.yaml
```yaml
# Cypress CY15B104Q FRAM SPI memory
description: Cypress 512 Kbit (64K x 8) SPI FRAM

compatible: "cypress,cy15b104q"

include: [spi-device.yaml]

properties:
  size:
    type: int
    required: true
    description: Memory size in bytes.
  spi-max-frequency:
    type: int
    default: 40000000
    description: Maximum SPI bus frequency (Hz).
```

## dts/bindings/sensor/adi,ad7685.yaml
```yaml
# Copyright (c) 2019, Linaro Limited
# SPDX-License-Identifier: Apache-2.0

description: AD7685 16-Bit digital SPI ADC

compatible: "adi,ad7685"

include: [sensor-device.yaml, spi-device.yaml]
```

## dts/bindings/sensor/adi,adt7320.yaml
```yaml
description: ADT7320 16-Bit digital SPI temperature sensor

compatible: "adi,adt7320"

include: [sensor-device.yaml, spi-device.yaml]
```

## west.yml
```yaml
west:
  url: https://github.com/zephyrproject-rtos/west
  revision: v1.5.0

manifest:
  remotes:
    - name: sdk-nrf
      url-base: https://github.com/nrfconnect
  projects:
    - name: nrf
      remote: sdk-nrf
      revision: v3.2.1
      repo-path: sdk-nrf
      import:
        path-prefix: external/sdk
  self:
    path: projects
```
